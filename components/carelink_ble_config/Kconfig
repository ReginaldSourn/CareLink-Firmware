## components/carelink_security/Kconfig
```kconfig
menu "CareLink security storage"
    config CARELINK_REPLAY_COUNTER_WINDOW
        int "Reserved replay-counter window"
        range 8 1024
        default 32
        help
            A new high-water mark is committed to NVS once per window. A
            reboot may skip unused values but can never reuse a reserved value.
endmenu
```

## sdkconfig.defaults
```kconfig
CONFIG_IDF_TARGET="esp32s3"
CONFIG_ESPTOOLPY_FLASHSIZE_16MB=y
CONFIG_ESP_CONSOLE_USB_SERIAL_JTAG=y
CONFIG_ESP_CONSOLE_SECONDARY_NONE=y
CONFIG_CARELINK_BUZZER_ENABLED=y
CONFIG_CARELINK_BUTTON_ENABLED=y
CONFIG_CARELINK_BUTTON_GPIO=4
CONFIG_CARELINK_IMU_ENABLED=y
CONFIG_CARELINK_IMU_SDA_GPIO=47
CONFIG_CARELINK_IMU_SCL_GPIO=48
```
