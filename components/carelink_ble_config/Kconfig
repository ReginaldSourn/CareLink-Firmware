## components/carelink_ble_config/Kconfig
```kconfig
menu "CareLink BLE mobile configuration"
    config CARELINK_BLE_CONFIG_ENABLED
        bool "Enable secure BLE mobile configuration"
        default n
        select BT_ENABLED
        select ESP_PROTOCOMM_SUPPORT_SECURITY_VERSION_2
        help
            Exposes the versioned CareLink runtime configuration through ESP-IDF
            Local Control over BLE with Security 2 (SRP-6a). A successful write
            is committed atomically and applied after an automatic restart.

    if CARELINK_BLE_CONFIG_ENABLED
        config CARELINK_BLE_SEC2_USERNAME
            string "Per-device Security 2 username"
            default ""
            help
                Manufacturing-provisioned username, 1-32 bytes. Use a unique
                value per pendant and deliver it out of band to the mobile app.

        config CARELINK_BLE_SEC2_PASSWORD
            string "Per-device Security 2 password"
            default ""
            help
                Manufacturing-provisioned password, 12-63 bytes. Never reuse it
                as the CareLink LoRa HMAC key or across multiple pendants.

        config CARELINK_BLE_WINDOW_SECONDS
            int "Configuration window after boot (seconds; 0 = always on)"
            range 0 3600
            default 300
            help
                Limits BLE advertising and configuration exposure to reduce
                battery use. Power-cycle the pendant to reopen a closed window.
    endif
endmenu
```

## components/carelink_board/Kconfig
```kconfig
menu "CareLink board"
    choice CARELINK_BOARD
        prompt "Heltec WiFi LoRa 32 V4 variant"
        default CARELINK_BOARD_HELTEC_V4_R2
        config CARELINK_BOARD_HELTEC_V4_R2
            bool "V4 ESP32-S3R2 (2 MB PSRAM)"
        config CARELINK_BOARD_HELTEC_V4_R8
            bool "V4 ESP32-S3R8 (8 MB PSRAM)"
    endchoice

    config CARELINK_GNSS_SOCKET_POWER
        bool "Enable power on the Heltec GNSS socket"
        default y
        help
            Active low: GPIO34 on R2, GPIO42 on R8. Disable for a
            separately powered breakout connected with jumper wires.

    config CARELINK_GPS_RX_GPIO
        int "ESP32 UART RX GPIO (connect to GNSS TX)"
        range 0 48
        default 39
        help
            The socket TX_GPS net is GPIO39, named from the GNSS perspective.
            Jumper wiring may use another free pin; reserved pins are rejected.

    config CARELINK_GPS_BAUD
        int "GNSS UART baud rate"
        range 1200 115200
        default 9600
    if CARELINK_IMU_ENABLED
        config CARELINK_IMU_SHARED_I2C
            bool "IMU shares OLED I2C0 (SDA17/SCL18)"
            default n
            help
                Enable only if the IMU is physically wired to the OLED bus.
                Otherwise the IMU uses I2C1 on the header pins below.

        config CARELINK_IMU_SDA_GPIO
            int "IMU SDA GPIO (-1 means not configured)"
            depends on !CARELINK_IMU_SHARED_I2C
            range -1 48
            default -1

        config CARELINK_IMU_SCL_GPIO
            int "IMU SCL GPIO (-1 means not configured)"
            depends on !CARELINK_IMU_SHARED_I2C
            range -1 48
            default -1

        config CARELINK_IMU_VEXT_POWER
            bool "IMU powered from Vext"
            default y
            help
                Enable Vext before initializing the IMU. Vext stays enabled
                because OLED and other external devices may share this supply.
    endif
endmenu
```

## components/carelink_button/Kconfig
```kconfig
menu "CareLink SOS button"
    config CARELINK_BUTTON_ENABLED
        bool "Enable dedicated SOS button"
        default n
        help
            Keep disabled until the production PCB GPIO and electrical active
            level are confirmed. GPIO0/PRG is never accepted as an SOS input.

    if CARELINK_BUTTON_ENABLED
        config CARELINK_BUTTON_GPIO
            int "Dedicated SOS button GPIO"
            range 1 48
            default 4
            help
                GPIO4 is J3 pin 15 on V4 R2. Only free Heltec V4 header GPIOs
                are accepted. Radio, FEM, OLED, GNSS, USB, strapping, memory
                and power pins are rejected.

        choice CARELINK_BUTTON_ACTIVE_LEVEL
            prompt "Button active level"
            default CARELINK_BUTTON_ACTIVE_LOW
            config CARELINK_BUTTON_ACTIVE_LOW
                bool "Active low"
            config CARELINK_BUTTON_ACTIVE_HIGH
                bool "Active high"
        endchoice

        choice CARELINK_BUTTON_PULL
            prompt "Internal pull resistor"
            default CARELINK_BUTTON_PULL_UP
            config CARELINK_BUTTON_PULL_UP
                bool "Pull up"
            config CARELINK_BUTTON_PULL_DOWN
                bool "Pull down"
            config CARELINK_BUTTON_PULL_NONE
                bool "No internal pull"
        endchoice

        config CARELINK_BUTTON_DEBOUNCE_MS
            int "Debounce interval (milliseconds)"
            range 10 200
            default 40

        config CARELINK_BUTTON_HOLD_MS
            int "SOS hold threshold (milliseconds)"
            range 500 10000
            default 1500

        config CARELINK_BUTTON_DOUBLE_PRESS_MS
            int "Double-press window (milliseconds)"
            range 200 1000
            default 450
            help
                A second debounced press inside this window sends a caregiver
                call request. This value must be shorter than the SOS hold
                threshold.

        config CARELINK_BUTTON_STUCK_MS
            int "Stuck-button threshold (milliseconds)"
            range 2000 3600000
            default 60000
            help
                Must be greater than the SOS hold threshold. Startup fails if
                an invalid custom configuration violates this relationship.

        config CARELINK_BUTTON_TASK_STACK_BYTES
            int "Button task stack (bytes)"
            range 2048 8192
            default 3072
    endif
endmenu
```

## components/carelink_buzzer/Kconfig
```kconfig
menu "CareLink buzzer"
    config CARELINK_BUZZER_ENABLED
        bool "Enable feedback buzzer"
        default n
        help
            Drives a passive piezo through an external transistor using PWM.
            The power-on hardware check operates without the incident service.
            When the incident service is enabled, non-blocking feedback patterns
            also follow authenticated SOS delivery state. Keep disabled when no
            buzzer circuit is fitted.

    if CARELINK_BUZZER_ENABLED
        config CARELINK_BUZZER_STARTUP_BEEP
            bool "Sound buzzer during startup"
            default y
            help
                Sounds one 500 ms non-blocking beep after PWM and the buzzer
                task initialize successfully. This provides an audible
                power-on hardware check.

        config CARELINK_BUZZER_GPIO
            int "Buzzer transistor control GPIO"
            range 1 48
            default 6
            help
                GPIO6 is J3 pin 17 on V4 R2. Startup rejects conflicts with
                GNSS, IMU, SOS button, radio, OLED, memory and power signals.

        config CARELINK_BUZZER_FREQUENCY_HZ
            int "Passive piezo frequency (Hz)"
            range 1000 5000
            default 2400

        config CARELINK_BUZZER_DUTY_PERCENT
            int "PWM duty percent"
            range 10 50
            default 50

        config CARELINK_BUZZER_TASK_STACK_BYTES
            int "Buzzer task stack (bytes)"
            range 1536 4096
            default 2048

        config CARELINK_BUZZER_TASK_PRIORITY
            int "Buzzer task priority"
            range 1 10
            default 5
    endif
endmenu
```

## components/carelink_gps/Kconfig
```kconfig
menu "CareLink GPS"
    config CARELINK_GPS_STALE_MS
        int "Maximum age of a current position (milliseconds)"
        range 1000 60000
        default 5000

    config CARELINK_GPS_RAW_LOG
        bool "Log received NMEA sentences for bench diagnostics"
        default n
        help
            Logs include location. Leave disabled for normal operation.
endmenu
```

## components/carelink_imu/Kconfig
```kconfig
menu "CareLink IMU"
    config CARELINK_IMU_ENABLED
        bool "Enable LSM6DSO (letter O) IMU"
        default n
        help
            Configure wiring under CareLink board before enabling. LSM6DS0
            (zero) is a different device and is not supported by this driver.

    if CARELINK_IMU_ENABLED
        config CARELINK_IMU_I2C_ADDRESS
            hex "IMU 7-bit I2C address (SA0 low: 0x6a; high: 0x6b)"
            range 0x6a 0x6b
            default 0x6a

        choice CARELINK_IMU_RATE
            prompt "Accelerometer and gyroscope output rate"
            default CARELINK_IMU_RATE_104
            config CARELINK_IMU_RATE_26
                bool "26 Hz"
            config CARELINK_IMU_RATE_52
                bool "52 Hz"
            config CARELINK_IMU_RATE_104
                bool "104 Hz"
            config CARELINK_IMU_RATE_208
                bool "208 Hz"
        endchoice
        config CARELINK_IMU_RATE_HZ
            int
            default 26 if CARELINK_IMU_RATE_26
            default 52 if CARELINK_IMU_RATE_52
            default 208 if CARELINK_IMU_RATE_208
            default 104

        choice CARELINK_IMU_ACCEL_RANGE
            prompt "Accelerometer full scale"
            default CARELINK_IMU_ACCEL_4G
            config CARELINK_IMU_ACCEL_2G
                bool "+/-2 g"
            config CARELINK_IMU_ACCEL_4G
                bool "+/-4 g"
            config CARELINK_IMU_ACCEL_8G
                bool "+/-8 g"
            config CARELINK_IMU_ACCEL_16G
                bool "+/-16 g"
        endchoice
        config CARELINK_IMU_ACCEL_RANGE_G
            int
            default 2 if CARELINK_IMU_ACCEL_2G
            default 8 if CARELINK_IMU_ACCEL_8G
            default 16 if CARELINK_IMU_ACCEL_16G
            default 4

        choice CARELINK_IMU_GYRO_RANGE
            prompt "Gyroscope full scale"
            default CARELINK_IMU_GYRO_500DPS
            config CARELINK_IMU_GYRO_250DPS
                bool "+/-250 degrees/s"
            config CARELINK_IMU_GYRO_500DPS
                bool "+/-500 degrees/s"
            config CARELINK_IMU_GYRO_1000DPS
                bool "+/-1000 degrees/s"
            config CARELINK_IMU_GYRO_2000DPS
                bool "+/-2000 degrees/s"
        endchoice
        config CARELINK_IMU_GYRO_RANGE_DPS
            int
            default 250 if CARELINK_IMU_GYRO_250DPS
            default 1000 if CARELINK_IMU_GYRO_1000DPS
            default 2000 if CARELINK_IMU_GYRO_2000DPS
            default 500

        config CARELINK_IMU_STALE_MS
            int "Maximum age of a usable sample (milliseconds)"
            range 100 10000
            default 500
    endif
endmenu
```

## components/carelink_incident/Kconfig
```kconfig
menu "CareLink incident service"
    config CARELINK_INCIDENT_ENABLED
        bool "Enable authenticated SOS incident service"
        depends on CARELINK_BUTTON_ENABLED && CARELINK_RADIO_ENABLED
        default n
        help
            Runs the button, durable SOS state machine, authenticated protocol,
            raw-LoRa TX/RX, and ACK/retry loop. A unique manufacturing-provisioned
            HMAC key is still required; startup fails closed without it.

    if CARELINK_INCIDENT_ENABLED
        config CARELINK_INCIDENT_RETRY_FIRST_MS
            int "First radio retry delay (ms)"
            range 500 60000
            default 2000

        config CARELINK_INCIDENT_RETRY_MAX_MS
            int "Maximum radio retry delay (ms)"
            range 1000 3600000
            default 60000

        config CARELINK_INCIDENT_MAX_ATTEMPTS
            int "Maximum transmissions per packet"
            range 1 100
            default 12
            help
                Includes the initial transmission. Regional airtime and duty-cycle
                requirements must be considered before increasing this value.

        config CARELINK_INCIDENT_LOCATION_UPDATE_MS
            int "Confirmed-incident location update interval (ms)"
            range 10000 3600000
            default 60000
            help
                Location updates begin only after the gateway radio-ACKs the
                incident start. This prevents an unacknowledged start from being
                superseded by a newer sequence.

        config CARELINK_INCIDENT_TASK_STACK_BYTES
            int "Incident task stack (bytes)"
            range 4096 16384
            default 8192

        config CARELINK_INCIDENT_TASK_PRIORITY
            int "Incident task priority"
            range 2 20
            default 8
    endif
endmenu
```

## components/carelink_oled/Kconfig
```kconfig
menu "CareLink OLED"
    config CARELINK_OLED_ENABLED
        bool "Enable Heltec onboard 128x64 OLED"
        default y
        help
            Uses I2C0, GPIO17/18, reset GPIO21, and enables the shared Vext rail.
            A missing display does not prevent GPS operation.

    config CARELINK_OLED_ROTATE_180
        bool "Rotate OLED by 180 degrees"
        default n
        depends on CARELINK_OLED_ENABLED
endmenu
```

## components/carelink_radio/Kconfig
```kconfig
menu "CareLink radio"
    config CARELINK_RADIO_ENABLED
        bool "Enable the CareLink SX1262 radio"
        default n
        help
            Enable raw LoRa transmission through the on-board SX1262. The
            application must still call carelink_radio_init() from the task
            that will own all subsequent radio operations.

    choice CARELINK_RADIO_BOARD_PROFILE
        prompt "Heltec radio board profile"
        depends on CARELINK_RADIO_ENABLED
        default CARELINK_RADIO_BOARD_HELTEC_V42_R2
        help
            The PCB revision selects the external RF front-end GPIO and
            polarity. Selecting the wrong profile can prevent reception or
            drive the front end in the wrong direction during transmission.

        config CARELINK_RADIO_BOARD_HELTEC_V42_R2
            bool "Heltec V4.2 S3R2 / GC1109"

        config CARELINK_RADIO_BOARD_HELTEC_V431_R2
            bool "Heltec V4.3.1 S3R2 / KCT8103L"

        config CARELINK_RADIO_BOARD_HELTEC_V4_R8
            bool "Heltec V4-R8 / KCT8103L"
    endchoice

    config CARELINK_RADIO_FREQUENCY_HZ
        int "Raw LoRa carrier frequency (Hz)"
        depends on CARELINK_RADIO_ENABLED
        range 150000000 960000000
        default 915000000
        help
            Must exactly match the Rolork gateway. The 915 MHz default is a
            compatibility value, not permission to transmit. Set a legal
            frequency, power, and duty cycle for the deployment country.

    config CARELINK_RADIO_TX_POWER_DBM
        int "SX1262 conducted TX power (dBm)"
        depends on CARELINK_RADIO_ENABLED
        range -9 14
        default 0
        help
            Low initial SX1262 drive setting before the Heltec external RF
            front end. Do not increase it until final radiated power, front-end
            input limits, thermal behavior, and regional limits are verified.

    config CARELINK_RADIO_BUSY_TIMEOUT_MS
        int "Maximum BUSY wait (ms)"
        depends on CARELINK_RADIO_ENABLED
        range 10 5000
        default 1000

    config CARELINK_RADIO_TX_TIMEOUT_MS
        int "Maximum packet transmission time (ms)"
        depends on CARELINK_RADIO_ENABLED
        range 100 30000
        default 5000

    config CARELINK_RADIO_RX_MAX_WAIT_MS
        int "Maximum receive poll wait (ms)"
        depends on CARELINK_RADIO_ENABLED
        range 1 30000
        default 1000
        help
            Upper bound accepted by carelink_radio_receive(). A zero timeout
            remains available for nonblocking polling.
endmenu
```
